## build/devices/esp32/xsProj-esp32h2/sdkconfig.defaults
```kconfig
CONFIG_BOOTLOADER_LOG_LEVEL_NONE=y
CONFIG_APP_RETRIEVE_LEN_ELF_SHA=16
CONFIG_BOOT_ROM_LOG_ALWAYS_OFF=y
CONFIG_ESPTOOLPY_FLASHSIZE_4MB=y
CONFIG_PARTITION_TABLE_CUSTOM=y
CONFIG_BT_ENABLED=y
CONFIG_BT_NIMBLE_ENABLED=y
CONFIG_BT_NIMBLE_LOG_LEVEL_NONE=y
CONFIG_BT_NIMBLE_EXT_ADV=y
# CONFIG_ESP_HTTP_CLIENT_ENABLE_HTTPS is not set
# CONFIG_ESP_INT_WDT is not set
# CONFIG_ESP_TASK_WDT_EN is not set
CONFIG_ESP_BROWNOUT_DET_LVL_SEL_7=y
CONFIG_FREERTOS_HZ=1000
CONFIG_FREERTOS_USE_TRACE_FACILITY=y
CONFIG_LOG_DEFAULT_LEVEL_NONE=y
CONFIG_LWIP_TCP_SND_BUF_DEFAULT=5744
CONFIG_LWIP_TCP_WND_DEFAULT=5744
CONFIG_MBEDTLS_ECP_RESTARTABLE=y
```
